## buildroot-external/Config.in
```kconfig
source "$BR2_EXTERNAL_ZIGQTOS_PATH/package/bluetooth-rtl8723/Config.in"
source "$BR2_EXTERNAL_ZIGQTOS_PATH/package/eq3_char_loop/Config.in"
source "$BR2_EXTERNAL_ZIGQTOS_PATH/package/gasket/Config.in"
source "$BR2_EXTERNAL_ZIGQTOS_PATH/package/generic_raw_uart/Config.in"
source "$BR2_EXTERNAL_ZIGQTOS_PATH/package/hardkernel-boot/Config.in"
source "$BR2_EXTERNAL_ZIGQTOS_PATH/package/khadas-boot/Config.in"
source "$BR2_EXTERNAL_ZIGQTOS_PATH/package/os-agent/Config.in"
source "$BR2_EXTERNAL_ZIGQTOS_PATH/package/pi-bluetooth/Config.in"
source "$BR2_EXTERNAL_ZIGQTOS_PATH/package/qemu-guest-agent/Config.in"
source "$BR2_EXTERNAL_ZIGQTOS_PATH/package/lxd-guest-agent/Config.in"
source "$BR2_EXTERNAL_ZIGQTOS_PATH/package/rpi-eeprom/Config.in"
source "$BR2_EXTERNAL_ZIGQTOS_PATH/package/rpi-rf-mod/Config.in"
source "$BR2_EXTERNAL_ZIGQTOS_PATH/package/rtl88x2bu/Config.in"
source "$BR2_EXTERNAL_ZIGQTOS_PATH/package/rtl8821cu/Config.in"
source "$BR2_EXTERNAL_ZIGQTOS_PATH/package/udisks2/Config.in"
source "$BR2_EXTERNAL_ZIGQTOS_PATH/package/xe-guest-utilities/Config.in"
```
